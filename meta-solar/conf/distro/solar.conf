## meta-solar/conf/distro/solar.conf
```bitbake
#TCLIBC = "musl"

DISTRO_FEATURES = "largefile 3g wifi usbhost systemd xattr ext2 ipv4 ${DISTRO_FEATURES_LIBC}"

DISTRO_FEATURES_BACKFILL_CONSIDERED = "pulseaudio sysvinit bluez5 gobject-introspection-data"

# Drop WiSPR support from connman to drop GnuTLS dependency
#PACKAGECONFIG_pn-connman = "systemd iptables"
# Use OpenSSL instead of GnuTLS
PACKAGECONFIG_pn-wpa-supplicant = "openssl"

VIRTUAL-RUNTIME_init_manager = "systemd"
VIRTUAL-RUNTIME_initscripts = ""

# If we don't want to build all locales we can select the ones we want here... 
# just comment this out in order to build all locales.  These are not
# automatically installed into the image, that is selected elsewhere.
GLIBC_GENERATE_LOCALES = "en_US.UTF-8"
```

## meta-solar/conf/layer.conf
```bitbake
BBPATH .= ":${LAYERDIR}"
BBFILES += "${LAYERDIR}/recipes-*/*/*.bb \
            ${LAYERDIR}/recipes-*/*/*.bbappend"

BBFILE_COLLECTIONS += "solar"
BBFILE_PATTERN_solar := "^${LAYERDIR}/"
BBFILE_PRIORITY_solar = "200"

LAYERSERIES_COMPAT_solar = "thud"

LAYERVERSION_solar = "1"
LAYERDEPENDS_solar = "core"
```

## meta-solar/conf/machine/solarevk.conf
```bitbake
#MACHINEOVERRIDES = "imx6ullevk:${MACHINE}"

DISTRO ?= "solar"

include conf/machine/imx6ullevk.conf

KERNEL_DEVICETREE = "imx6ull-14x14-evk.dtb"
PREFERRED_PROVIDER_virtual/kernel = "linux-solar"
```
